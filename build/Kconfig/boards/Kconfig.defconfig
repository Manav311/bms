## build/Kconfig/boards/Kconfig.defconfig
```kconfig
# Load Zephyr board defconfig descriptions.
osource "C:/ncs/v3.1.0/zephyr/boards/nordic/nrf52dk/Kconfig.defconfig"
```

## build/Kconfig/boards/Kconfig.sysbuild
```kconfig
# Load Sysbuild board Kconfig descriptions.
osource "C:/ncs/v3.1.0/zephyr/boards/nordic/nrf52dk/Kconfig.sysbuild"
```
